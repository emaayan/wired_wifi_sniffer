## wired_wifi_sniffer/sdkconfig.defaults
```kconfig
# Reduce bootloader log verbosity
CONFIG_BOOTLOADER_LOG_LEVEL_WARN=y
CONFIG_BOOTLOADER_LOG_LEVEL=2

# Increase main task stack size
CONFIG_ESP_MAIN_TASK_STACK_SIZE=7168

# Enable filesystem
CONFIG_PARTITION_TABLE_CUSTOM=y
CONFIG_PARTITION_TABLE_CUSTOM_FILENAME="partitions.csv"
CONFIG_PARTITION_TABLE_FILENAME="partitions.csv"

CONFIG_ESPTOOLPY_FLASHSIZE="4MB"
CONFIG_ESPTOOLPY_FLASHSIZE_4MB=y

#CONFIG_PARTITION_TABLE_OFFSET=0x8000
#CONFIG_PARTITION_TABLE_MD5=y
CONFIG_FATFS_LFN_HEAP=y

# Enable FreeRTOS stats formatting functions, needed for 'tasks' command
CONFIG_FREERTOS_USE_TRACE_FACILITY=y
CONFIG_FREERTOS_USE_STATS_FORMATTING_FUNCTIONS=y


CONFIG_TINYUSB_TASK_AFFINITY_CPU0=y
CONFIG_TINYUSB_INIT_IN_DEFAULT_TASK=y
CONFIG_TINYUSB_TASK_PRIORITY=20

#CONFIG_TINYUSB_MODE_SLAVE=y

#CONFIG_TINYUSB_DEBUG_LEVEL=1
#CONFIG_TINYUSB_NET_MODE_RNDIS=y
CONFIG_TINYUSB_NET_MODE_NCM=y

#CONFIG_SNIFFER_WORK_QUEUE_LEN=500
#CONFIG_SNIFFER_TASK_STACK_SIZE=4096
#CONFIG_SNIFFER_TASK_PRIORITY=8

#CONFIG_ESP_COEX_SW_COEXIST_ENABLE=y

CONFIG_ESP_WIFI_STATIC_RX_BUFFER_NUM=20
CONFIG_ESP_WIFI_DYNAMIC_RX_BUFFER_NUM=100
#CONFIG_ESP_WIFI_TX_BUFFER_TYPE=0
#CONFIG_ESP_WIFI_STATIC_TX_BUFFER=y
#CONFIG_ESP_WIFI_STATIC_TX_BUFFER_NUM=16
#CONFIG_ESP_WIFI_CACHE_TX_BUFFER_NUM=32
CONFIG_ESP_WIFI_RX_BA_WIN=32

#CONFIG_ESP_WIFI_TASK_PINNED_TO_CORE_0=y
#CONFIG_ESP_WIFI_SOFTAP_BEACON_MAX_LEN=752
#CONFIG_ESP_WIFI_MGMT_SBUF_NUM=32
#CONFIG_ESP_WIFI_DEBUG_LOG_ENABLE=y
#CONFIG_ESP_WIFI_ENABLE_WPA3_SAE=y


#CONFIG_LWIP_DEBUG=y
#CONFIG_LWIP_NETIF_DEBUG=y
#CONFIG_LWIP_DNS_SUPPORT_MDNS_QUERIES=n
CONFIG_MDNS_MAX_INTERFACES=5
CONFIG_LWIP_IPV6=n
CONFIG_LWIP_ND6=n
CONFIG_LWIP_FORCE_ROUTER_FORWARDING=n
CONFIG_LWIP_IP6_FRAG=n
CONFIG_LWIP_MAX_ACTIVE_TCP=6
CONFIG_LWIP_MAX_LISTENING_TCP=6

#CONFIG_LWIP_DHCPS=n
#CONFIG_LWIP_DHCPS_LEASE_UNIT=n

CONFIG_LWIP_MAX_SOCKETS=16

CONFIG_LWIP_TCP_SND_BUF_DEFAULT=10000
CONFIG_LWIP_TCP_HIGH_SPEED_RETRANSMISSION=y
CONFIG_LWIP_TCP_SACK_OUT=y

#CONFIG_LWIP_TCP_DEBUG=y
#CONFIG_LWIP_TCP_MAXRTX=12
#CONFIG_LWIP_TCP_SYNMAXRTX=6
#CONFIG_LWIP_TCP_MSS=5760
#CONFIG_LWIP_TCP_TMR_INTERVAL=250
#CONFIG_LWIP_TCP_MSL=60000
#CONFIG_LWIP_TCP_SND_BUF_DEFAULT=65534
#CONFIG_LWIP_TCP_WND_DEFAULT=65534
#CONFIG_LWIP_TCP_RECVMBOX_SIZE=64
#CONFIG_LWIP_TCP_OVERSIZE_MSS=y
#CONFIG_LWIP_TCP_RTO_TIME=1500
```
